SECTIONS
{
    .text 0xC0000000 :
    {
        *(kernel_main);
        *(.text*);
    }
    .data :
    {
        *(.data*);
    }
    .rodata :
    {
        *(.rodata*);
    }
    .bss :
    {
        *(.bss*);
    }
}
