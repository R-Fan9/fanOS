SECTIONS
{
    .text 0x50000 :
    {
        *(prekernel_setup);
        *(.text*);
    }
    .data :
    {
        *(.data*);
    }
    .rodata :
    {
        *(.rodata*);
    }
    .bss :
    {
        *(.bss*);
    }
}
